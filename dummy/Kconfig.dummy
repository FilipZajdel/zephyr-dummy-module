## dummy/Kconfig.dummy
```kconfig
menu "DUMMY"
    config ENABLE_DUMMY
        bool "Enables dummy"
        default n
        help
          Enables dummy
endmenu
```

## dummy/dts/bindings/sensor/nordic,dummy.yaml
```yaml
description: Dummy sensor

compatible: "nordic,dummy"

include: base.yaml

properties:
  dummy-prop1:
    type: int
    required: true
    description: |
      The sensor needs some dummy property

  dummy-prop-enum:
    type: string
    required: true
    enum:
      - "hot"
      - "cold"
    description: |
      Another dummy property. Enum this time.
```

## west.yml
```yaml
manifest:
  self:
    path: application
  remotes:
    - name: nrf
      url-base: https://github.com/FilipZajdel
  projects:
    - name: sdk-nrf
      remote: nrf
      path: nrf
      revision: build_info_fork
      import:
        path-prefix: external
      clone-depth: 1
```
