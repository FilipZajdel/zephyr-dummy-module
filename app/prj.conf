## CMakeLists.txt
```
# SPDX-License-Identifier: Apache-2.0

cmake_minimum_required(VERSION 3.20.0)

set(DUMMY_PATH ${CMAKE_CURRENT_SOURCE_DIR}/../dummy)

list(APPEND EXTRA_ZEPHYR_MODULES ${DUMMY_PATH})
find_package(Zephyr REQUIRED HINTS $ENV{ZEPHYR_BASE})
project(app)

target_sources(app PRIVATE src/main.c)
```

## Kconfig
```
source "Kconfig.zephyr"

menu "Blinky app configuration"

config SLEEP_TIME_MS
    int "LED toggle interval"
    default 500
    help
      Set the interval between each LED's toggle.

endmenu
```

## prj.conf
```kconfig
CONFIG_GPIO=y
CONFIG_ENABLE_DUMMY=y
```

## boards/nrf52833dk_nrf52833.overlay
```dts
/{

    dummy {
        compatible = "nordic,dummy";
        dummy-prop-enum = "hot";
        dummy-prop1 = < 0x11 >;
    };
};
```

## src/main.c
```c
/*
 * Copyright (c) 2016 Intel Corporation
 *
 * SPDX-License-Identifier: Apache-2.0
 */

#include <stdio.h>
#include <zephyr/kernel.h>
#include <zephyr/drivers/gpio.h>
#include <dummy.h>

/* 1000 msec = 1 sec */
#define SLEEP_TIME_MS   CONFIG_SLEEP_TIME_MS

/* The devicetree node identifier for the "led0" alias. */
#define LED0_NODE DT_ALIAS(led0)

/*
 * A build error on this line means your board is unsupported.
 * See the sample documentation for information on how to fix this.
 */
static const struct gpio_dt_spec led = GPIO_DT_SPEC_GET(LED0_NODE, gpios);

int main(void)
{
	int ret;
	bool led_state = true;

	if (!gpio_is_ready_dt(&led)) {
		return 0;
	}

	ret = gpio_pin_configure_dt(&led, GPIO_OUTPUT_ACTIVE);
	if (ret < 0) {
		return 0;
	}

	init_dummy();

	while (1) {
		ret = gpio_pin_toggle_dt(&led);
		if (ret < 0) {
			return 0;
		}

		led_state = !led_state;
		printf("LED state: %s\n", led_state ? "ON" : "OFF");
		k_msleep(SLEEP_TIME_MS);
	}
	return 0;
}
```
